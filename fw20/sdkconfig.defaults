## fw20/sdkconfig.defaults
```kconfig
# Waveshare ESP32-C6-Touch-AMOLED-1.32
CONFIG_IDF_TARGET="esp32c6"

# 16 MB W25Q128 flash
CONFIG_ESPTOOLPY_FLASHSIZE_16MB=y
CONFIG_ESPTOOLPY_FLASHMODE_QIO=y

# Custom partition table (dual OTA + storage)
CONFIG_PARTITION_TABLE_CUSTOM=y
CONFIG_PARTITION_TABLE_CUSTOM_FILENAME="partitions.csv"

# Console over built-in USB Serial/JTAG
CONFIG_ESP_CONSOLE_USB_SERIAL_JTAG=y

# LVGL
CONFIG_LV_COLOR_DEPTH_16=y
CONFIG_LV_FONT_MONTSERRAT_32=y
CONFIG_FREERTOS_HZ=1000
CONFIG_LV_FONT_MONTSERRAT_16=y
CONFIG_LV_USE_QRCODE=y
```
